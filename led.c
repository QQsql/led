#include "stc12c5a.h"
#define uint unsigned int
#define uchar unsigned char


 uint flag=0;


/*******************************************************************************
*陇东学院字模，高电位有效，按列扫描显示，每个数据高位对应低层led
*
*******************************************************************************/

uint code WORD[4][32]={
						//陇	
						{0x00,0x00,0x00,0x00,0xFE,0xFF,0x02,0x08,0x22,0x10,0xDA,0x88,0x06,0x47,0x10,0x30,
						0x10,0x0E,0xFF,0x41,0x10,0x20,0xF0,0x3F,0x11,0x48,0x16,0x46,0x90,0x41,0x10,0x78},
						//东
						{0x00,0x00,0x00,0x00,0x08,0x20,0x88,0x11,0x48,0x09,0x28,0x05,0x18,0x41,0x0F,0x81,
						0xE8,0x7F,0x08,0x01,0x08,0x01,0x08,0x05,0x08,0x09,0x08,0x11,0x08,0x20,0x00,0x00},
						 //学
						{0x00,0x00,0x40,0x04,0x30,0x04,0x11,0x04,0x96,0x04,0x90,0x04,0x90,0x44,0x91,0x84,
						0x96,0x7E,0x90,0x06,0x90,0x05,0x98,0x04,0x14,0x04,0x13,0x04,0x50,0x04,0x30,0x04},
						 //院
						{0x00,0x00,0x00,0x00,0xFE,0xFF,0x22,0x04,0x5A,0x08,0x86,0x07,0x10,0x80,0x0C,0x41,
						0x24,0x31,0x24,0x0F,0x25,0x01,0x26,0x01,0x24,0x3F,0x24,0x41,0x14,0x41,0x0C,0x71}
					};




/*******************************************************************************
* 函 数 名         : Delay10ms
* 函数功能		   : 延时函数，延时10ms
* 输    入         : 无
* 输    出         : 无
*******************************************************************************/

void Delay10ms(unsigned int c)   //误差 0us
{
    unsigned char a, b;

	//--c已经在传递过来的时候已经赋值了，所以在for语句第一句就不用赋值了--//
    for (;c>0;c--)
	{
		for (b=38;b>0;b--)
		{
			for (a=5;a>0;a--);
		}
           
	}
        
}




/*******************************************************************************
* 函 数 名         : LDXY_disp
* 函数功能		   : 显示陇东学院
* 输    入         : 无
* 输    出         : 无
*******************************************************************************/
void LDXY_disp()
{
	uchar i,j;   	//循环变量
		uint DOWN,UP;	 //字模值，DOWN为P4,P5口对应的8位(P4口高四位，P5口低四位)，UP对应P2口8位
	  
		for(i=0;i<=3;i++)
			for(j=0;j<=31;j++)
				{
					
					UP=WORD[i][j];
					DOWN=WORD[i][++j];  //字模数组里面紧跟着的两个数据对应一列

					
					P2=~UP;
					P4=~(DOWN&0x0f);	//数据低位对应高处的led灯
					P5=~((DOWN>>4)&0x0f);
					 	
					Delay10ms(1); 		//亮灯的时间长度，延时越长，扫点越宽


					 P2=0xff;			//关灯
		   			 P4=0x0f;
		   			 P5=0x0f;
				
						
					 Delay10ms(4); 		//每列之间的时间间隔，调字宽
				}

}



/*******************************************************************************
* 函 数 名         : I_disp
* 函数功能		   : 显示移动的I，扩展功能
* 输    入         : 无
* 输    出         : 无
* 说    明		   ：
*******************************************************************************/
void I_disp()
{

}





/*******************************************************************************
* 函 数 名         : singlely_disp
* 函数功能		   : 逐个显示陇东学院，扩展功能
* 输    入         : 无
* 输    出         : 无
* 说    明		   ：
*******************************************************************************/
void singlely_disp()
{
	
}



/*******************************************************************************
* 函 数 名         : int0_led
* 函数功能		   : 外部中断0 处理子程序，显示字模内容
* 输    入         : 无
* 输    出         : 无
* 说    明		   ：P3.2口低电平或下降沿触发
*******************************************************************************/
void int0_led(void) interrupt 0
{	 

	flag++; 	

	if(flag<=1000)
		LDXY_disp();		//显示陇东学院1000次
	else if(flag>1000&&flag<=2000)
		I_disp();			//显示旋转I
	else
		singlely_disp();	//逐个显示陇东学院
		
}





/*******************************************************************************
* 函 数 名         : main
* 函数功能		   : 主函数
* 输    入         : 无
* 输    出         : 无
*******************************************************************************/


void main(void)
{
			
	   IT0=1;  //外部中断0设置为下降沿触发方式，INT0'/P3.2口上的下降沿信号可以触发INT0中断
	   EX0=1;  //外部中断0中断允许位，EX0=1,允许外部中断0
	   EA=1;   //开全局中断
	  
	  while(1)
	   {
		   //初始化各管脚，灯全灭
		   P2=0xff;	
		   P4=0x0f;
		   P5=0x0f;
	   }
	   
	  
   


}




/**************************************************************************************
* 芯片管脚对应的设备表，LED灯低电位有效
*
*
*******IO口对应LED灯*********
*    LED灯从高到低排列
*
*LED灯->IO口	 |
*L9->P2.0		 
*L10->P2.1
*L11->P2.2
*L12->P2.3
*L13->P2.4
*L14->P2.5
*L15->P2.6
*L16->P2.7
*L38->P4.0
*L39->P4.1
*L40->P4.2
*L41->P4.3
*L42->P5.0
*L43->p5.1
*L44->P5.2
*L45->P5.3
***********************


*红外管+->P32
***************************************************************************************/

